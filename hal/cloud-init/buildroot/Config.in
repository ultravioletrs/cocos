## hal/cloud-init/buildroot/package/tdx-rtmr-extend/Config.in
```kconfig
config BR2_PACKAGE_TDX_RTMR_EXTEND
	bool "tdx-rtmr-extend"
	depends on BR2_PACKAGE_HOST_GO_TARGET_ARCH_SUPPORTS
	help
	  Small helper used by the early initramfs to extend Intel TDX
	  RTMR registers through Linux configfs-tsm using the
	  github.com/google/go-tdx-guest RTMR library.
```

## hal/disk/configs/cocos_defconfig
```kconfig
# Architecture
BR2_x86_64=y

# System
BR2_TARGET_GENERIC_HOSTNAME="cocos"
BR2_TARGET_GENERIC_ISSUE="Welcome to Cocos"
BR2_PACKAGE_DHCP=y
BR2_PACKAGE_DHCP_CLIENT=y
BR2_INIT_SYSTEMD=y
BR2_SYSTEM_BIN_SH_BASH=y

# Filesystem
# BR2_TARGET_ROOTFS_TAR is not set
# Initramfs (rootfs.cpio.gz) is built by post-image.sh from only the FDE tools,
# not from the full target rootfs.  The full rootfs goes to rootfs.ext4 (disk image).
BR2_ROOTFS_OVERLAY="$(BR2_EXTERNAL_COCOS_PATH)/board/rootfs-overlay"

# Patches for existing Buildroot packages
BR2_GLOBAL_PATCH_DIR="$(BR2_EXTERNAL_COCOS_PATH)/patches"

# Bootloader
BR2_TARGET_GRUB2=y
BR2_TARGET_GRUB2_X86_64_EFI=y
BR2_TARGET_GRUB2_BUILTIN_MODULES_EFI="boot linux echo normal part_gpt fat ls search"

# Disk image
BR2_TARGET_ROOTFS_EXT2=y
BR2_TARGET_ROOTFS_EXT2_4=y
BR2_TARGET_ROOTFS_EXT2_SIZE="10G"
BR2_PACKAGE_HOST_GENIMAGE=y
BR2_PACKAGE_HOST_CRYPTSETUP=y

# Image
BR2_ROOTFS_POST_BUILD_SCRIPT="$(BR2_EXTERNAL_COCOS_PATH)/board/cocos/post-build.sh"

# Image
BR2_ROOTFS_POST_IMAGE_SCRIPT="$(BR2_EXTERNAL_COCOS_PATH)/board/cocos/post-image.sh"
BR2_ROOTFS_POST_SCRIPT_ARGS="$(BR2_DEFCONFIG)"

# Linux headers same as kernel
BR2_PACKAGE_HOST_LINUX_HEADERS_CUSTOM_6_11=y
BR2_TOOLCHAIN_HEADERS_LATEST=y
BR2_TOOLCHAIN_HEADERS_AT_LEAST="6.11-rc7"

# Kernel
BR2_LINUX_KERNEL=y
BR2_LINUX_KERNEL_CUSTOM_GIT=y
BR2_LINUX_KERNEL_CUSTOM_REPO_URL="https://github.com/coconut-svsm/linux.git"
BR2_LINUX_KERNEL_CUSTOM_REPO_VERSION="svsm"
BR2_LINUX_KERNEL_VERSION="svsm"
BR2_LINUX_KERNEL_PATCH=""
BR2_LINUX_KERNEL_USE_CUSTOM_CONFIG=y
BR2_LINUX_KERNEL_CUSTOM_CONFIG_FILE="$(BR2_EXTERNAL_COCOS_PATH)/board/cocos/linux.config"
BR2_LINUX_KERNEL_NEEDS_HOST_LIBELF=y

# host-qemu for gitlab testing
BR2_PACKAGE_HOST_QEMU=y
BR2_PACKAGE_HOST_QEMU_SYSTEM_MODE=y

# Python
BR2_PACKAGE_PYTHON3=y
BR2_PACKAGE_PYTHON_PIP=y
BR2_PACKAGE_BZIP2=y
BR2_PACKAGE_XZ=y
BR2_PACKAGE_ZIP=y
BR2_PACKAGE_PYTHON3_ZLIB=y
BR2_PACKAGE_PYTHON3_XZ=y
BR2_PACKAGE_PYTHON3_BZIP2=y
BR2_INSTALL_LIBSTDCPP=y
BR2_TOOLCHAIN_BUILDROOT_CXX=y
BR2_PACKAGE_HOST_GCC_TARGET=y
BR2_TOOLCHAIN_BUILDROOT_LIBSTDCPP=y
BR2_PACKAGE_GCC=y
BR2_PACKAGE_GCC_TARGET=y
BR2_PACKAGE_LIBSTDCPP=y

# FDE
BR2_PACKAGE_NBD=y
BR2_PACKAGE_NBD_CLIENT=y
BR2_PACKAGE_CRYPTSETUP=y
BR2_ROOTFS_DEVICE_CREATION_DYNAMIC_EUDEV=y
BR2_PACKAGE_EUDEV=y
BR2_PACKAGE_HAS_UDEV=y
BR2_PACKAGE_MULTIPATH_TOOLS=y
BR2_PACKAGE_UTIL_LINUX_BINARIES=y
BR2_PACKAGE_E2FSPROGS=y
BR2_LINUX_KERNEL_NEEDS_HOST_PAHOLE=y

# TPM2
BR2_PACKAGE_TPM2_TOOLS=y
BR2_PACKAGE_COREUTILS=y

# Docker
BR2_PACKAGE_LIBSECCOMP_ARCH_SUPPORTS=y
BR2_PACKAGE_LIBSECCOMP=y
BR2_PACKAGE_CA_CERTIFICATES=y
BR2_PACKAGE_DOCKER_CLI=y
BR2_PACKAGE_DOCKER_COMPOSE=y
BR2_PACKAGE_DOCKER_ENGINE=y
BR2_PACKAGE_CONTAINERD=y
BR2_PACKAGE_RUNC=y
BR2_PACKAGE_IPTABLES=y

# Skopeo for OCI image handling with CoCo Keyprovider
BR2_PACKAGE_SKOPEO=y
BR2_PACKAGE_GPGME=y
BR2_PACKAGE_LVM2=y
BR2_PACKAGE_LVM2_STANDARD_INSTALL=y
BR2_PACKAGE_9PFS=y

# Host tools
BR2_PACKAGE_HOST_RUSTC=y
BR2_PACKAGE_HOST_RUST_BIN=y

# Cocos AI Packages
BR2_PACKAGE_AGENT=y
# BR2_PACKAGE_CC_ATTESTATION_AGENT is not set
```

## hal/disk/package/egress-proxy/Config.in
```kconfig
config BR2_PACKAGE_EGRESS_PROXY
	bool "egress-proxy"
	help
	  Cocos AI Egress Proxy Service.

	  https://github.com/ultravioletrs/cocos
```

## hal/disk/package/log-forwarder/Config.in
```kconfig
config BR2_PACKAGE_LOG_FORWARDER
	bool "log-forwarder"
	help
	  Cocos AI Log Forwarder service.
```

## hal/linux/Config.in
```kconfig
source "$BR2_EXTERNAL_COCOS_PATH/package/agent/Config.in"
source "$BR2_EXTERNAL_COCOS_PATH/package/attestation-service/Config.in"
source "$BR2_EXTERNAL_COCOS_PATH/package/cc-attestation-agent/Config.in"
source "$BR2_EXTERNAL_COCOS_PATH/package/coco-keyprovider/Config.in"
source "$BR2_EXTERNAL_COCOS_PATH/package/skopeo/Config.in"
source "$BR2_EXTERNAL_COCOS_PATH/package/wasmedge/Config.in"
source "$BR2_EXTERNAL_COCOS_PATH/package/log-forwarder/Config.in"
source "$BR2_EXTERNAL_COCOS_PATH/package/computation-runner/Config.in"
source "$BR2_EXTERNAL_COCOS_PATH/package/egress-proxy/Config.in"
source "$BR2_EXTERNAL_COCOS_PATH/package/ingress-proxy/Config.in"
```

## hal/linux/configs/cocos_defconfig
```kconfig
# Architecture
BR2_x86_64=y

# System
BR2_TARGET_GENERIC_HOSTNAME="cocos"
BR2_TARGET_GENERIC_ISSUE="Welcome to Cocos"
BR2_PACKAGE_DHCP=y
BR2_PACKAGE_DHCP_CLIENT=y
BR2_SYSTEM_BIN_SH_BASH=y
BR2_PACKAGE_BUSYBOX_SHOW_OTHERS=y

# Filesystem
# BR2_TARGET_ROOTFS_TAR is not set
BR2_TARGET_ROOTFS_CPIO=y
BR2_TARGET_ROOTFS_CPIO_FULL=y
BR2_TARGET_ROOTFS_CPIO_GZIP=y
BR2_TARGET_ROOTFS_OVERLAY="overlay"
BR2_PACKAGE_9PFS=y

# Image
BR2_ROOTFS_POST_BUILD_SCRIPT="$(BR2_EXTERNAL_COCOS_PATH)/board/cocos/post-build.sh"

# Image
BR2_ROOTFS_POST_IMAGE_SCRIPT="$(BR2_EXTERNAL_COCOS_PATH)/board/cocos/post-image.sh"
BR2_ROOTFS_POST_SCRIPT_ARGS="$(BR2_DEFCONFIG)"

# Linux headers same as kernel
BR2_PACKAGE_HOST_LINUX_HEADERS_CUSTOM_6_11=y
BR2_TOOLCHAIN_HEADERS_LATEST=y
BR2_TOOLCHAIN_HEADERS_AT_LEAST="6.11-rc7"

# Kernel
BR2_LINUX_KERNEL=y
BR2_LINUX_KERNEL_CUSTOM_GIT=y
BR2_LINUX_KERNEL_CUSTOM_REPO_URL="https://github.com/coconut-svsm/linux.git"
BR2_LINUX_KERNEL_CUSTOM_REPO_VERSION="svsm"
BR2_LINUX_KERNEL_VERSION="svsm"
BR2_LINUX_KERNEL_PATCH=""
BR2_LINUX_KERNEL_USE_CUSTOM_CONFIG=y
BR2_LINUX_KERNEL_CUSTOM_CONFIG_FILE="$(BR2_EXTERNAL_COCOS_PATH)/board/cocos/linux.config"
BR2_LINUX_KERNEL_NEEDS_HOST_LIBELF=y

# host-qemu for gitlab testing
BR2_PACKAGE_HOST_QEMU=y
BR2_PACKAGE_HOST_QEMU_SYSTEM_MODE=y

# FDE
BR2_PACKAGE_NBD=y
BR2_PACKAGE_NBD_CLIENT=y
BR2_PACKAGE_CRYPTSETUP=y
BR2_ROOTFS_DEVICE_CREATION_DYNAMIC_EUDE=y
BR2_PACKAGE_EUDEV=y
BR2_PACKAGE_HAS_UDEV=y
BR2_PACKAGE_MULTIPATH_TOOLS=y
BR2_PACKAGE_UTIL_LINUX_BINARIES=y

# TPM2
BR2_PACKAGE_TPM2_TOOLS=y
BR2_PACKAGE_COREUTILS=y

# Python
BR2_PACKAGE_PYTHON3=y
BR2_PACKAGE_PYTHON_PIP=y
BR2_PACKAGE_BZIP2=y
BR2_PACKAGE_XZ=y
BR2_PACKAGE_ZIP=y
BR2_PACKAGE_PYTHON3_ZLIB=y
BR2_PACKAGE_PYTHON3_XZ=y
BR2_PACKAGE_PYTHON3_BZIP2=y
BR2_INSTALL_LIBSTDCPP=y
BR2_TOOLCHAIN_BUILDROOT_CXX=y
BR2_PACKAGE_HOST_GCC_TARGET=y
BR2_TOOLCHAIN_BUILDROOT_LIBSTDCPP=y
BR2_PACKAGE_GCC=y
BR2_PACKAGE_GCC_TARGET=y
BR2_PACKAGE_LIBSTDCPP=y
```

## hal/linux/package/agent/Config.in
```kconfig
config BR2_PACKAGE_AGENT
	bool "agent"
	default y
	select BR2_PACKAGE_ATTESTATION_SERVICE
	select BR2_PACKAGE_LOG_FORWARDER
	select BR2_PACKAGE_COMPUTATION_RUNNER
	select BR2_PACKAGE_INGRESS_PROXY
	select BR2_PACKAGE_EGRESS_PROXY
	help
	  Confidential Computing Agent is a state machine capable of
	  receiving datasets and algorithm, running computations, and
	  fetching the attestation report from within the
	  Confidential VM.
```

## hal/linux/package/attestation-service/Config.in
```kconfig
config BR2_PACKAGE_ATTESTATION_SERVICE
	bool
	default y
	help
	  Cocos AI attestation service that generates EAT tokens
	  for TEE attestation (SNP, TDX, vTPM, Azure).
	  
	  This service can optionally use the Confidential Containers
	  attestation-agent as a backend provider via gRPC.
	  
	  https://github.com/ultravioletrs/cocos
```

## hal/linux/package/cc-attestation-agent/Config.in
```kconfig
config BR2_PACKAGE_CC_ATTESTATION_AGENT
	bool
	default y if BR2_PACKAGE_ATTESTATION_BACKEND_CC
	depends on BR2_PACKAGE_HOST_RUSTC
	select BR2_PACKAGE_PROTOBUF
	select BR2_PACKAGE_OPENSSL
	help
	  Confidential Containers attestation-agent for TEE attestation
	  with optional KBS (Key Broker Service) protocol support.
	  
	  This package provides an alternative attestation backend that
	  can operate in local mode or connect to a KBS for remote
	  attestation and encrypted secret provisioning.
	  
	  https://github.com/confidential-containers/guest-components

if BR2_PACKAGE_CC_ATTESTATION_AGENT

config BR2_PACKAGE_CC_ATTESTATION_AGENT_KBS_URL
	string "Default KBS URL (optional)"
	default ""
	help
	  Optional default KBS (Key Broker Service) URL for remote
	  attestation and secret provisioning.
	  
	  Leave empty to operate in local attestation mode only.
	  Can be overridden per-computation via environment variables.
	  
	  Example: https://kbs.example.com:8080

endif
```

## hal/linux/package/cloud-init/Config.in
```kconfig
config BR2_PACKAGE_CLOUD_INIT
    bool "cloud-init"
    depends on BR2_PACKAGE_PYTHON3
    default y
    help
      Cloud-init is an industry-standard tool for configuring cloud instances
```

## hal/linux/package/coco-keyprovider/Config.in
```kconfig
config BR2_PACKAGE_COCO_KEYPROVIDER
	bool "coco-keyprovider"
	depends on BR2_PACKAGE_HOST_RUSTC_ARCH_SUPPORTS
	select BR2_PACKAGE_HOST_RUSTC
	help
	  CoCo Keyprovider is a keyprovider tool for generating and
	  decrypting CoCo-compatible encrypted images. It implements
	  the ocicrypt keyprovider protocol to decrypt OCI image layers
	  using the Key Broker Service (KBS).

	  https://github.com/confidential-containers/guest-components
```

## hal/linux/package/computation-runner/Config.in
```kconfig
config BR2_PACKAGE_COMPUTATION_RUNNER
	bool "computation-runner"
	select BR2_PACKAGE_LOG_FORWARDER
	help
	  Cocos AI Computation Runner service.
```

## hal/linux/package/ingress-proxy/Config.in
```kconfig
config BR2_PACKAGE_INGRESS_PROXY
	bool "ingress-proxy"
	help
	  Cocos Ingress Proxy service.
```

## hal/linux/package/skopeo/Config.in
```kconfig
config BR2_PACKAGE_SKOPEO
	bool "skopeo"
	depends on BR2_PACKAGE_HOST_GO_TARGET_ARCH_SUPPORTS
	depends on BR2_PACKAGE_HOST_GO_TARGET_CGO_LINKING_SUPPORTS
	select BR2_PACKAGE_LIBGPGME
	select BR2_PACKAGE_LVM2
	help
	  Skopeo is a command line utility for various operations on
	  container images and image repositories. It supports OCI
	  image encryption and decryption via ocicrypt.

	  https://github.com/containers/skopeo

comment "skopeo needs a toolchain w/ threads"
	depends on !BR2_TOOLCHAIN_HAS_THREADS
```

## hal/linux/package/wasmedge/Config.in
```kconfig
config BR2_PACKAGE_WASMEDGE
    bool "wasmedge"
	  default y
    help
      Wasmedge is a standalone runtime for WebAssembly.
      https://wasmedge.org/docs/
```

## hal/linux/package/wasmtime/Config.in
```kconfig
config BR2_PACKAGE_WASMTIME
    bool "wasmtime"
    help
      Wasmtime is a standalone runtime for WebAssembly.
      https://github.com/bytecodealliance/wasmtime
```
